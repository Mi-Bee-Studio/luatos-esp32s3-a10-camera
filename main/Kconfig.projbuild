## main/Kconfig.projbuild
```kconfig
menu "MiBeeCam Features"

    config MIBEECAM_ENABLE_WEBHOOK
        bool "Enable Webhook HTTP client"
        default y
        help
            Enable webhook notification support. When enabled, the device can
            send HTTP POST requests to a configured URL on motion detection.

    config MIBEECAM_ENABLE_ONVIF
        bool "Enable ONVIF Profile S (discovery + minimal SOAP)"
        default y
        help
            Enable ONVIF discovery and minimal SOAP service for compatibility
            with NVR systems that support ONVIF Profile S.

    config MIBEECAM_ENABLE_WS
        bool "Enable WebSocket push support"
        default y
        help
            Enable WebSocket server for real-time push of events and frames
            to connected web clients.

    config MIBEECAM_ENABLE_FRAME_BROADCASTER
        bool "Enable frame broadcaster module"
        default y
        help
            Enable the frame broadcasting subsystem that distributes camera
            frames to multiple consumers (streamer, motion detection, etc.).

    config MIBEECAM_ENABLE_BACKUP_SSID
        bool "Enable backup WiFi SSID support"
        default y
        help
            Enable backup/secondary WiFi SSID for failover when the primary
            WiFi network is unavailable.

    config MIBEECAM_ENABLE_MDNS
        bool "Enable mDNS hostname advertisement"
        default y
        help
            Enable mDNS service advertisement so the device can be discovered
            as <hostname>.local on the local network.

    config MIBEECAM_ENABLE_WIFI_SCAN
        bool "Enable WiFi scan capability"
        default y
        help
            Enable WiFi access point scanning for the web UI configuration
            page, allowing users to select nearby networks.

    config MIBEE_CAM_DEFAULT_WEB_PASSWORD
        string "Default web management password"
        default "mibeecam2026"
        help
            First-boot / empty-migration default for the web management
            password (contract v1.1). mibeecam2026 is the documented public
            default (safe for README/docs); local builds may override it
            via the git-ignored sdkconfig.

endmenu

menu "mibee-cam CSI Motion Sensing (ESPectre)"

    config MIBEE_CSI_MOTION
        bool "Enable ESPectre WiFi CSI motion sensing"
        default n
        select ESP_WIFI_CSI_ENABLED if SOC_WIFI_CSI_SUPPORT
        help
            Embed the ESPectre sensing runtime (components/espectre, GPLv3)
            and start it after WiFi init. Logs motion-state changes only —
            no API/contract surface yet (family pilot, 2026-09-06). Detection
            profile / CSI cadence are tuned under "ESPectre Sensing".
            With this option off the firmware is byte-identical to the
            pre-ESPectre baseline (verified on seeed 2026-09-06).
            WARNING: this board has NO PSRAM and ~40-47KB steady-state free
            heap; the sensing runtime costs ~22KB internal RAM — measure
            /metrics MemFree after enabling and watch the 15KB health line.

endmenu
```
